/*
 * Allwinner Technology CO., Ltd. sun50iw6p1 soc board.
 *
 * soc board support.
 */

/dts-v1/;

#include "sun50iw6p1.dtsi"

/{

	soc@03000000 {

	};

	wlan:wlan {
		compatible = "allwinner,sunxi-wlan";
		clocks = <&clk_losc_out>;
		status = "okay";
	};
};
