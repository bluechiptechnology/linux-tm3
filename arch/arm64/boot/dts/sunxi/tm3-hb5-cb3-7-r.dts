
#include "tm3-hb5-cb3-7-c.dts"


/* resistive touch screen */
&tsc2046{
	status = "okay";
	android,ti,x-min = /bits/ 16 <112>;
	android,ti,x-max = /bits/ 16 <3970>;
	android,ti,y-max = /bits/ 16 <170>;
	android,ti,y-min = /bits/ 16 <3856>;
};


&pcap {
	status = "disabled";
};

