
#include "tm3-hb8-43-c.dts"

&tsc2046{
	status = "okay";
	ti,x-min = /bits/ 16 <130>;
	ti,x-max = /bits/ 16 <3990>;
	ti,y-max = /bits/ 16 <200>;
	ti,y-min = /bits/ 16 <3926>;
};

&pcap{
	status = "disabled";
};

