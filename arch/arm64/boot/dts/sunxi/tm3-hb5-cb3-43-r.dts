
#include "tm3-hb5-cb3-43-c.dts"

&tsc2046{
	status = "okay";
	ti,x-min = /bits/ 16 <380>;
	ti,x-max = /bits/ 16 <3670>;
	ti,y-max = /bits/ 16 <500>;
	ti,y-min = /bits/ 16 <3056>;
};

&pcap{
	status = "disabled";
};

