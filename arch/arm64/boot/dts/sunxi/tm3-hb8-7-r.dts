
#include "tm3-hb8-7-c.dts"


/* resistive touch screen */
&tsc2046{
	status = "okay";
	ti,x-min = /bits/ 16 <112>;
	ti,x-max = /bits/ 16 <3970>;
	ti,y-max = /bits/ 16 <170>;
	ti,y-min = /bits/ 16 <3856>;
};


&pcap {
	status = "disabled";
};

