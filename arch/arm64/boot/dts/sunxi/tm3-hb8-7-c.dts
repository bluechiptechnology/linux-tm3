
#include "tm3-hb8.dts"

&lcd0 {
	lcd_x = <800>;
	lcd_y = <480>;
	lcd_width = <154>;
	lcd_height = <93>;
	lcd_dclk_freq = <33>;
	lcd_hbp = <46>;
	lcd_ht = <1056>;
	lcd_hspw = <46>;
	lcd_vbp = <24>;
	lcd_vt = <526>;
	lcd_vspw = <2>;
	lcd_hv_clk_phase = <0x1>;
	lcd_hv_sync_polarity = <0x0>;
};

&pcap {
	status = "okay";
	xresolution = /bits/ 16 <800>;
	yresolution = /bits/ 16 <480>;
};
