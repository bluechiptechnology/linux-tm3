
#include "tm3-hb5-43-c.dts"

&tsc2046{
	status = "okay";
	android,ti,x-min = /bits/ 16 <130>;
	android,ti,x-max = /bits/ 16 <3990>;
	android,ti,y-max = /bits/ 16 <200>;
	android,ti,y-min = /bits/ 16 <3926>;
};

&pcap{
	status = "disabled";
};

