## drivers/net/wireless/rtl8188eu/Kconfig
```kconfig
config RTL8188EU
	tristate "Realtek 8188E USB WiFi - Edimax N150 V2"
	depends on USB
	---help---
	  Help message of RTL8188EU
```

## drivers/net/wireless/ssv6x5x/Kconfig
```kconfig
menu "iComm-semi 6X5X WLAN support"
config SSV6X5X
	tristate "SSV6X5X Wireless driver"
	depends on MAC80211 && MMC
	---help---
		Enable iComm-semi SSV6X5X WLAN kernel driver.

if SSV6X5X

config SSV6X5X_HCI_BLE
	bool "Enable Bluetooth LE"
	default n
	---help---
		Enable Bluetooth LE.


config SSV6X5X_VERBOSE
	bool "Verbose kernel output"
	default n
	---help---
		Enable verbose kernel logging for debugging purposes.

endif #SSV6X5X

endmenu
```
